/*
 * Copyright (c) 2022 The ZMK Contributors
 *
 * SPDX-License-Identifier: MIT
 */

/ {
    chosen {
        zmk,kscan = &kscan1;
    };

    kscan1: kscan {
        compatible = "zmk,kscan-gpio-matrix";
        label = "KSCAN";
    };
};