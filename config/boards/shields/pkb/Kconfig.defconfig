## config/boards/shields/pkb/Kconfig.defconfig
```kconfig
# Copyright (c) 2020 The ZMK Contributors
# SPDX-License-Identifier: MIT

if SHIELD_PKB_CENTRAL

config ZMK_KEYBOARD_NAME
    default "pkb"

config SPI
    default y

config SSD1306
    default y

config ZMK_SPLIT_BLE_ROLE_CENTRAL
    default y

config ZMK_USB
    default y

endif

if SHIELD_PKB_LEFT || SHIELD_PKB_RIGHT || SHIELD_PKB_CENTRAL

config ZMK_SPLIT
    default y

config ZMK_BLE
    default y

endif
```

## config/boards/shields/pkb/Kconfig.shield
```kconfig
# Copyright (c) 2020 The ZMK Contributors
# SPDX-License-Identifier: MIT

config SHIELD_PKB_CENTAL
    def_bool $(shields_list_contains,pkb_dongle)

config SHIELD_PKB_LEFT
    def_bool $(shields_list_contains,pkb_left)

config SHIELD_PKB_RIGHT
    def_bool $(shields_list_contains,pkb_right)
```
